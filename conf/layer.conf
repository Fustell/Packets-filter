## conf/layer.conf
```bitbake
# We have a conf and classes directory, add to BBPATH
BBPATH .= ":${LAYERDIR}"

# We have recipes-* directories, add to BBFILES
BBFILES += "${LAYERDIR}/recipes-*/*/*.bb \
            ${LAYERDIR}/recipes-*/*/*.bbappend"

BBFILE_COLLECTIONS += "meta-packetmod"
BBFILE_PATTERN_meta-packetmod = "^${LAYERDIR}/"
BBFILE_PRIORITY_meta-packetmod = "6"

LAYERDEPENDS_meta-packetmod = "core"
LAYERSERIES_COMPAT_meta-packetmod = "kirkstone"
```
